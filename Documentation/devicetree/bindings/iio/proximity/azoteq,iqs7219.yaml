## Documentation/devicetree/bindings/iio/proximity/azoteq,iqs7219.yaml
```yaml
# SPDX-License-Identifier: (GPL-2.0-only OR BSD-2-Clause)
%YAML 1.2
---
$id: http://devicetree.org/schemas/iio/proximity/azoteq,iqs7219.yaml#
$schema: http://devicetree.org/meta-schemas/core.yaml#

title: Azoteq IQS7219A SAR Proximity Sensor

maintainers:
  - Jeff LaBundy <jeff@labundy.com>

description:
  The Azoteq IQS7219A is a SAR proximity sensor capable of both self and mutual
  capacitive sensing.

properties:
  compatible:
    const: azoteq,iqs7219a

  reg:
    maxItems: 1

  irq-gpios:
    maxItems: 1
    description:
      Specifies the GPIO connected to the device's active-low RDY output.

  reset-gpios:
    maxItems: 1
    description:
      Specifies the GPIO connected to the device's active-low MCLR input. The
      device is temporarily held in hardware reset prior to initialization if
      this property is present.

  azoteq,rate-np-segment:
    $ref: /schemas/types.yaml#/definitions/uint32
    enum: [0, 1, 2, 3]
    description: |
      Specifies the number of normal-power mode reporting periods to be skipped
      before both channels are updated during ultra-low-power mode as follows:
      0: 4
      1: 8
      2: 16
      3: 32

  azoteq,power-mode:
    $ref: /schemas/types.yaml#/definitions/uint32
    enum: [0, 1, 2, 3]
    description: |
      Specifies the power mode as follows:
      0: Normal power
      1: Low power
      2: Ultra-low power
      3: Automatic

  azoteq,streaming-comms:
    type: boolean
    description: Places the device in streaming communication mode.

  azoteq,timeout-comms-ms:
    minimum: 0
    maximum: 255
    default: 20
    description:
      Specifies the delay (in ms) before a communication window is closed.

  azoteq,timeout-ati-ms:
    minimum: 0
    maximum: 65535
    description:
      Specifies the delay (in ms) before ATI is retried following an ATI error.

  azoteq,rate-ati-ms:
    minimum: 0
    maximum: 65535
    description: Specifies the rate (in ms) at which ATI status is evaluated.

  azoteq,timeout-np-ms:
    minimum: 0
    maximum: 65535
    description:
      Specifies the length of time (in ms) to wait for an event before moving
      from normal-power mode to low-power mode.

  azoteq,rate-np-ms:
    minimum: 0
    maximum: 3000
    description: Specifies the report rate (in ms) during normal-power mode.

  azoteq,timeout-lp-ms:
    minimum: 0
    maximum: 65535
    description:
      Specifies the length of time (in ms) to wait for an event before moving
      from low-power mode to ultra-low-power mode.

  azoteq,rate-lp-ms:
    minimum: 0
    maximum: 3000
    description: Specifies the report rate (in ms) during low-power mode.

  azoteq,timeout-ulp-ms:
    minimum: 0
    maximum: 65535
    description:
      Specifies the rate (in ms) at which channels not regularly sampled during
      ultra-low-power mode are updated.

  azoteq,rate-ulp-ms:
    minimum: 0
    maximum: 3000
    description: Specifies the report rate (in ms) during ultra-low-power mode.

  azoteq,proj-bias:
    $ref: /schemas/types.yaml#/definitions/uint32
    enum: [0, 1, 2, 3]
    description: |
      Specifies the bias current applied during mutual (projected) capacitive
      sensing as follows:
      0: 2 uA
      1: 5 uA
      2: 7 uA
      3: 10 uA

patternProperties:
  "^cycle-[0-1]$":
    type: object
    description: Represents a conversion cycle serving one sensing channel.

    properties:
      azoteq,channel-select:
        $ref: /schemas/types.yaml#/definitions/uint32
        enum: [0, 1, 255]
        description: Specifies the channel served by the cycle (255 = none).

      azoteq,sense-mode:
        $ref: /schemas/types.yaml#/definitions/uint32
        enum: [0, 3]
        description: |
          Specifies the cycle's sensing mode as follows:
          0: Self capacitive
          3: Mutual capacitive

    additionalProperties: false

  "^sense-mode-(self|proj)$":
    type: object
    description:
      Represents all properties that define self or mutual (projected) sensing
      modes.

    properties:
      azoteq,vref-half:
        type: boolean
        description: Halves the discharge threshold from 1.0 V to 0.5 V.

      azoteq,samp-cap-double:
        type: boolean
        description: Doubles the sampling capacitance from 40 pF to 80 pF.

      azoteq,max-counts:
        $ref: /schemas/types.yaml#/definitions/uint32
        enum: [0, 1, 2, 3]
        description: |
          Specifies the maximum number of conversion periods (counts) that can
          be reported as follows:
          0: 1023
          1: 2047
          2: 4095
          3: 16384

    additionalProperties: false

  "^channel-[0-1]$":
    type: object
    description: Represents a single sensing channel.

    properties:
      azoteq,scan-mux:
        $ref: /schemas/types.yaml#/definitions/uint32
        enum: [0, 1, 2, 3, 4, 5]
        default: 0
        description: |
          Specifies which value is written to the triggered buffer as follows:
          0: Delta
          1: Filtered counts
          2: Raw counts
          3: Long-term average
          4: Variance
          5: PXS flags

      azoteq,counts-beta-lp:
        $ref: /schemas/types.yaml#/definitions/uint32
        minimum: 0
        maximum: 15
        description:
          Specifies the counts filter damping factor to be applied during
          low-power mode.

      azoteq,counts-beta-np:
        $ref: /schemas/types.yaml#/definitions/uint32
        minimum: 0
        maximum: 15
        description:
          Specifies the counts filter damping factor to be applied during
          normal-power mode.

      azoteq,lta-fast-beta-lp:
        $ref: /schemas/types.yaml#/definitions/uint32
        minimum: 0
        maximum: 15
        description:
          Specifies the long-term average filter fast damping factor to be
          applied during low-power mode.

      azoteq,lta-fast-beta-np:
        $ref: /schemas/types.yaml#/definitions/uint32
        minimum: 0
        maximum: 15
        description:
          Specifies the long-term average filter fast damping factor to be
          applied during normal-power mode.

      azoteq,lta-beta-lp:
        $ref: /schemas/types.yaml#/definitions/uint32
        minimum: 0
        maximum: 15
        description:
          Specifies the long-term average filter damping factor to be applied
          during low-power mode.

      azoteq,lta-beta-np:
        $ref: /schemas/types.yaml#/definitions/uint32
        minimum: 0
        maximum: 15
        description:
          Specifies the long-term average filter damping factor to be applied
          during normal-power mode.

      azoteq,direction-enable:
        type: boolean
        description: Enables the directionality state machine.

      azoteq,invert-enable:
        type: boolean
        description:
          Inverts the polarity of the states reported for events relative to
          their respective thresholds.

      azoteq,dual-direction:
        type: boolean
        description:
          Specifies that the channel's long-term average is to freeze in the
          presence of either increasing or decreasing counts, thereby permit-
          ting events to be reported in either direction.

      azoteq,conv-period:
        $ref: /schemas/types.yaml#/definitions/uint32
        minimum: 0
        maximum: 255
        description: Specifies the channel's conversion period.

      azoteq,conv-frac:
        $ref: /schemas/types.yaml#/definitions/uint32
        minimum: 0
        maximum: 255
        description: Specifies the channel's conversion frequency fraction.

      azoteq,conv-scale:
        $ref: /schemas/types.yaml#/definitions/uint32
        enum: [0, 1, 2, 3]
        description: |
          Specifies the channel's conversion frequency scaling factor as
          follows:
          0: 1
          1: 2
          2: 4
          3: 8

      azoteq,rx-enable:
        $ref: /schemas/types.yaml#/definitions/uint32-array
        minItems: 1
        maxItems: 4
        items:
          minimum: 0
          maximum: 3
        description: Specifies the CRx pin(s) associated with the channel.

      azoteq,tx-enable:
        $ref: /schemas/types.yaml#/definitions/uint32-array
        minItems: 1
        maxItems: 9
        items:
          minimum: 0
          maximum: 8
        description: Specifies the CTx pin(s) associated with the channel.

      azoteq,ati-base:
        $ref: /schemas/types.yaml#/definitions/uint32
        minimum: 0
        maximum: 500
        description: Specifies the channel's ATI base.

      azoteq,ati-target:
        $ref: /schemas/types.yaml#/definitions/uint32
        minimum: 0
        maximum: 4000
        description: Specifies the channel's ATI target.

      azoteq,ati-band:
        $ref: /schemas/types.yaml#/definitions/uint32
        minimum: 0
        maximum: 1500
        description: Specifies the channel's ATI band.

      azoteq,ati-mode:
        $ref: /schemas/types.yaml#/definitions/uint32
        enum: [0, 1, 2, 3, 4, 5]
        description: |
          Specifies the channel's ATI mode as follows:
          0: Disabled
          1: Compensation
          2: Compensation divider
          3: Fine fractional divider
          4: Coarse fractional divider
          5: Full

      azoteq,ati-frac-div-coarse:
        $ref: /schemas/types.yaml#/definitions/uint32
        minimum: 0
        maximum: 31
        description: Specifies the preloaded ATI coarse fractional divider.

      azoteq,ati-frac-div-fine:
        $ref: /schemas/types.yaml#/definitions/uint32
        minimum: 0
        maximum: 31
        description: Specifies the preloaded ATI fine fractional divider.

      azoteq,ati-comp-select:
        $ref: /schemas/types.yaml#/definitions/uint32
        minimum: 0
        maximum: 1023
        description: Specifies the preloaded ATI compensation selection.

      azoteq,thresh:
        $ref: /schemas/types.yaml#/definitions/uint32
        minimum: 0
        maximum: 65535
        description: Specifies the channel's variance threshold.

      azoteq,fast-filt-band:
        $ref: /schemas/types.yaml#/definitions/uint32
        minimum: 0
        maximum: 255
        description: Specifies the channel's fast filter band.

    patternProperties:
      "^event-(halt|prox|touch)$":
        type: object
        description:
          Represents a halt, proximity or touch event reported by the channel.

        allOf:
          - $ref: ../../pinctrl/pincfg-node.yaml#

        properties:
          azoteq,trigger-disable:
            type: boolean
            description:
              Specifies that the event is to remain masked such that the RDY
              output is not asserted on its behalf.

          azoteq,timeout-active-ms:
            minimum: 0
            maximum: 65535
            description:
              Specifies the length of time (in ms) to wait before considering
              an event to be inactive.

          azoteq,thresh:
            $ref: /schemas/types.yaml#/definitions/uint32
            minimum: 0
            maximum: 65535
            description: Specifies the threshold for the event.

          azoteq,lta-track:
            type: boolean
            description:
              Multiplies the threshold by the channel's long-term average and
              divides it by 2^16.

          azoteq,hyst:
            $ref: /schemas/types.yaml#/definitions/uint32
            minimum: 0
            maximum: 65535
            description: Specifies the hysteresis for the event.

          azoteq,debounce-enter:
            $ref: /schemas/types.yaml#/definitions/uint32
            minimum: 0
            maximum: 255
            description: Specifies the event's debounce entrance factor.

          azoteq,debounce-exit:
            $ref: /schemas/types.yaml#/definitions/uint32
            minimum: 0
            maximum: 255
            description: Specifies the event's debounce exit factor.

          azoteq,gpio-select:
            $ref: /schemas/types.yaml#/definitions/uint32
            enum: [1, 2, 5]
            description:
              Specifies the GPIO mapped to the event. The use of any GPIO places
              the device in stand-alone mode, during which it cannot communicate
              over I2C.

          azoteq,invert-enable:
            type: boolean
            description:
              Inverts the polarity of the GPIO while the GPIO is configured as a
              push-pull output.

          drive-open-drain: true

        dependencies:
          azoteq,invert-enable: ["azoteq,gpio-select"]
          drive-open-drain: ["azoteq,gpio-select"]

        additionalProperties: false

    additionalProperties: false

  "^ati-[0-1]$":
    type: object
    description: Represents the ATI algorithm corresponding to either channel.

    properties:
      azoteq,ati-frac-mult-coarse:
        $ref: /schemas/types.yaml#/definitions/uint32
        minimum: 0
        maximum: 15
        description: Specifies the channel's ATI coarse fractional multiplier.

      azoteq,ati-frac-div-coarse:
        $ref: /schemas/types.yaml#/definitions/uint32
        minimum: 0
        maximum: 31
        description: Specifies the channel's ATI coarse fractional divider.

      azoteq,ati-frac-div-fine:
        $ref: /schemas/types.yaml#/definitions/uint32
        minimum: 0
        maximum: 31
        description: Specifies the channel's ATI fine fractional divider.

      azoteq,ati-comp-div:
        $ref: /schemas/types.yaml#/definitions/uint32
        minimum: 0
        maximum: 31
        description: Specifies the channel's ATI compensation divider.

      azoteq,ati-comp-select:
        $ref: /schemas/types.yaml#/definitions/uint32
        minimum: 0
        maximum: 1023
        description: Specifies the channel's ATI compensation selection.

    additionalProperties: false

required:
  - compatible
  - reg
  - irq-gpios

additionalProperties: false

examples:
  - |
    #include <dt-bindings/gpio/gpio.h>

    i2c {
            #address-cells = <1>;
            #size-cells = <0>;

            proximity@56 {
                    compatible = "azoteq,iqs7219a";
                    reg = <0x56>;
                    irq-gpios = <&gpio 4 GPIO_ACTIVE_LOW>;

                    channel-0 {
                            event-prox {
                                    azoteq,lta-track;
                            };
                    };

                    channel-1 {
                            event-prox {
                                    azoteq,lta-track;
                            };
                    };
            };
    };

...
```
