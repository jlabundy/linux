## Documentation/devicetree/bindings/input/azoteq,common.yaml
```yaml
# SPDX-License-Identifier: (GPL-2.0-only OR BSD-2-Clause)
%YAML 1.2
---
$id: http://devicetree.org/schemas/input/azoteq,common.yaml#
$schema: http://devicetree.org/meta-schemas/core.yaml#

title: Common schema binding for Azoteq devices

maintainers:
  - Jeff LaBundy <jeff@labundy.com>

properties:
  azoteq,max-counts:
    $ref: /schemas/types.yaml#/definitions/uint32
    enum: [0, 1, 2, 3]
    description: |
      Specifies the maximum number of conversion periods (counts) that can be
      reported as follows:
      0: 1023
      1: 2047
      2: 4095
      3: 16384

  azoteq,auto-mode:
    $ref: /schemas/types.yaml#/definitions/uint32
    enum: [0, 1, 2, 3]
    description: |
      Specifies the number of conversions to occur before an interrupt is
      generated as follows:
      0: 4
      1: 8
      2: 16
      3: 32

  azoteq,suspend-mode:
    $ref: /schemas/types.yaml#/definitions/uint32
    enum: [0, 1, 2, 3]
    default: 0
    description: |
      Specifies the power mode during suspend as follows:
      0: Automatic (same as normal runtime, i.e. suspend/resume disabled)
      1: Low power (all sensing at a reduced reporting rate)
      2: Ultra-low power (ULP channel proximity sensing)
      3: Halt (no sensing)

  azoteq,clk-div:
    type: boolean
    description: Divides the device's core clock by a factor of 4.

  azoteq,ulp-update:
    $ref: /schemas/types.yaml#/definitions/uint32
    enum: [0, 1, 2, 3, 4, 5, 6, 7]
    default: 3
    description: |
      Specifies the rate at which the trackpad, generic and Hall channels are
      updated during ultra-low-power mode as follows:
      0: 8
      1: 13
      2: 28
      3: 54
      4: 89
      5: 135
      6: 190
      7: 256

  azoteq,gpio3-select:
    $ref: /schemas/types.yaml#/definitions/uint32
    enum: [0, 1, 2, 3, 4, 5, 6, 7]
    default: 1
    description: |
      Selects the channel or group of channels for which the GPIO3 pin
      represents touch state as follows:
      0: None
      1: ULP channel
      2: Trackpad
      3: Trackpad
      4: Generic channel 0
      5: Generic channel 1
      6: Generic channel 2
      7: Hall channel

  azoteq,reseed-select:
    $ref: /schemas/types.yaml#/definitions/uint32
    enum: [0, 1, 2, 3]
    default: 0
    description: |
      Specifies the event(s) that prompt the device to reseed (i.e. reset the
      long-term average) of an associated channel as follows:
      0: None
      1: Proximity
      2: Proximity or touch
      3: Proximity, touch or deep touch

  azoteq,reseed-offset:
    type: boolean
    description:
      Applies an 8-count offset to all long-term averages upon either ATI or
      reseed events.

  azoteq,reseed-disable:
    type: boolean
    description:
      Prevents the channel from being reseeded if the long-term average
      timeout (defined in 'azoteq,timeout-lta') expires.

  azoteq,filt-str-lp-lta:
    $ref: /schemas/types.yaml#/definitions/uint32
    enum: [0, 1, 2, 3]
    default: 0
    description:
      Specifies the long-term average filter strength during low-power mode.

  azoteq,filt-str-lp-cnt:
    $ref: /schemas/types.yaml#/definitions/uint32
    enum: [0, 1, 2, 3]
    default: 0
    description:
      Specifies the raw count filter strength during low-power mode.

  azoteq,filt-str-np-lta:
    $ref: /schemas/types.yaml#/definitions/uint32
    enum: [0, 1, 2, 3]
    default: 0
    description:
      Specifies the long-term average filter strength during normal-power mode.

  azoteq,filt-str-np-cnt:
    $ref: /schemas/types.yaml#/definitions/uint32
    enum: [0, 1, 2, 3]
    default: 0
    description:
      Specifies the raw count filter strength during normal-power mode.

  azoteq,lta-beta-lp:
    $ref: /schemas/types.yaml#/definitions/uint32
    minimum: 0
    maximum: 15
    description:
      Specifies the long-term average filter damping factor to be applied during
      low-power mode.

  azoteq,lta-beta-np:
    $ref: /schemas/types.yaml#/definitions/uint32
    minimum: 0
    maximum: 15
    description:
      Specifies the long-term average filter damping factor to be applied during
      normal-power mode.

  azoteq,counts-beta-lp:
    $ref: /schemas/types.yaml#/definitions/uint32
    minimum: 0
    maximum: 15
    description:
      Specifies the counts filter damping factor to be applied during low-power
      mode.

  azoteq,counts-beta-np:
    $ref: /schemas/types.yaml#/definitions/uint32
    minimum: 0
    maximum: 15
    description:
      Specifies the counts filter damping factor to be applied during normal-
      power mode.

  azoteq,lta-fast-beta-lp:
    $ref: /schemas/types.yaml#/definitions/uint32
    minimum: 0
    maximum: 15
    description:
      Specifies the long-term average filter fast damping factor to be applied
      during low-power mode.

  azoteq,lta-fast-beta-np:
    $ref: /schemas/types.yaml#/definitions/uint32
    minimum: 0
    maximum: 15
    description:
      Specifies the long-term average filter fast damping factor to be applied
      during normal-power mode.

  azoteq,fast-filt-band:
    $ref: /schemas/types.yaml#/definitions/uint32
    minimum: 0
    maximum: 65535
    description: Specifies the fast filter band.

  azoteq,power-mode:
    $ref: /schemas/types.yaml#/definitions/uint32
    enum: [0, 1, 2, 3, 4, 5]
    description: |
      Specifies the power mode as follows:
      0: Normal power
      1: Low power
      2: Ultra-low power
      3: Halt
      4: Automatic
      5: Automatic (without ultra-low-power mode)

  azoteq,rate-halt-ms:
    minimum: 0
    maximum: 3000
    description: Specifies the report rate (in ms) during halt mode.

  azoteq,timeout-pwr-ms:
    multipleOf: 512
    minimum: 0
    maximum: 130560
    default: 2560
    description:
      Specifies the length of time (in ms) to wait for an event during normal-
      power mode before transitioning to low-power mode.

  azoteq,timeout-lta-ms:
    multipleOf: 512
    minimum: 0
    maximum: 130560
    default: 32768
    description:
      Specifies the length of time (in ms) to wait before resetting the long-
      term average of all channels. Specify the maximum timeout to disable it
      altogether.

  azoteq,timeout-xp-ms:
    minimum: 0
    maximum: 65000
    description:
      Specifies the length of time (in ms) to wait for an event before moving
      to the next power mode.

  azoteq,timeout-ati-ms:
    multipleOf: 500
    minimum: 0
    maximum: 32767500
    description:
      Specifies the delay (in ms) before ATI is retried following an ATI error.

  azoteq,rate-ati-ms:
    minimum: 0
    maximum: 65535
    description: Specifies the rate (in ms) at which ATI status is evaluated.

  azoteq,timeout-np-ms:
    minimum: 0
    maximum: 65535
    description:
      Specifies the length of time (in ms) to wait for an event before moving
      from normal-power mode to low-power mode.

  azoteq,rate-np-ms:
    minimum: 0
    maximum: 3000
    description: Specifies the report rate (in ms) during normal-power mode.

  azoteq,timeout-lp-ms:
    minimum: 0
    maximum: 65535
    description:
      Specifies the length of time (in ms) to wait for an event before moving
      from low-power mode to ultra-low-power mode.

  azoteq,rate-lp-ms:
    minimum: 0
    maximum: 3000
    description: Specifies the report rate (in ms) during low-power mode.

  azoteq,timeout-ulp-ms:
    minimum: 0
    maximum: 65535
    description:
      Specifies the rate (in ms) at which channels not regularly sampled during
      ultra-low-power mode are updated.

  azoteq,rate-ulp-ms:
    minimum: 0
    maximum: 3000
    description: Specifies the report rate (in ms) during ultra-low-power mode.

  azoteq,rate-active-ms:
    minimum: 0
    maximum: 65535
    description: Specifies the report rate (in ms) during active mode.

  azoteq,rate-touch-ms:
    minimum: 0
    maximum: 65535
    description: Specifies the report rate (in ms) during idle-touch mode.

  azoteq,rate-idle-ms:
    minimum: 0
    maximum: 65535
    description: Specifies the report rate (in ms) during idle mode.

  azoteq,rate-lp1-ms:
    minimum: 0
    maximum: 65535
    description: Specifies the report rate (in ms) during low-power mode 1.

  azoteq,rate-lp2-ms:
    minimum: 0
    maximum: 65535
    description: Specifies the report rate (in ms) during low-power mode 2.

  azoteq,rate-np-segment:
    $ref: /schemas/types.yaml#/definitions/uint32
    enum: [0, 1, 2, 3]
    description: |
      Specifies the number of normal-power mode reporting periods to be skipped
      before both channels are updated during ultra-low-power mode as follows:
      0: 4
      1: 8
      2: 16
      3: 32

  azoteq,timeout-active-ms:
    multipleOf: 1000
    minimum: 0
    maximum: 65535000
    description:
      Specifies the length of time (in ms) to wait for an event before moving
      from active mode to idle or idle-touch modes.

  azoteq,timeout-touch-ms:
    multipleOf: 1000
    minimum: 0
    maximum: 65535000
    description:
      Specifies the length of time (in ms) to wait for an event before moving
      from idle-touch mode to idle mode.

  azoteq,timeout-idle-ms:
    multipleOf: 1000
    minimum: 0
    maximum: 65535000
    description:
      Specifies the length of time (in ms) to wait for an event before moving
      from idle mode to low-power mode 1.

  azoteq,timeout-lp1-ms:
    multipleOf: 1000
    minimum: 0
    maximum: 65535000
    description:
      Specifies the length of time (in ms) to wait for an event before moving
      from low-power mode 1 to low-power mode 2.

  azoteq,timeout-lp2-ms:
    multipleOf: 1000
    minimum: 0
    maximum: 60000
    description:
      Specifies the rate (in ms) at which the trackpad reference values
      are updated during low-power modes 1 and 2.

  azoteq,timeout-comms-ms:
    minimum: 0
    maximum: 65535
    description:
      Specifies the delay (in ms) before a communication window is closed.

  azoteq,timeout-press-ms:
    multipleOf: 1000
    minimum: 0
    maximum: 60000
    description:
      Specifies the length of time (in ms) to wait before automatically
      releasing a press event. Specify zero to allow the press state to
      persist indefinitely.

  azoteq,fosc-freq:
    $ref: /schemas/types.yaml#/definitions/uint32
    enum: [0, 1]
    description: |
      Specifies the device's core clock frequency as follows:
      0: 14 MHz
      1: 18 MHz

  azoteq,fosc-trim:
    $ref: /schemas/types.yaml#/definitions/uint32
    minimum: 0
    maximum: 15
    description: Specifies the device's core clock frequency trim.

  azoteq,num-contacts:
    $ref: /schemas/types.yaml#/definitions/uint32
    minimum: 0
    maximum: 2
    default: 0
    description: Specifies the number of contacts reported by the device.

  azoteq,contact-split:
    $ref: /schemas/types.yaml#/definitions/uint32
    minimum: 0
    maximum: 255
    description: Specifies the contact (finger) split factor.

  azoteq,trim-x:
    $ref: /schemas/types.yaml#/definitions/uint32
    minimum: 0
    maximum: 255
    description: Specifies the horizontal trim width.

  azoteq,trim-y:
    $ref: /schemas/types.yaml#/definitions/uint32
    minimum: 0
    maximum: 255
    description: Specifies the vertical trim height.

  azoteq,num-rows:
    $ref: /schemas/types.yaml#/definitions/uint32
    minimum: 1
    maximum: 12
    description: Specifies the number of rows that comprise the trackpad.

  azoteq,num-cols:
    $ref: /schemas/types.yaml#/definitions/uint32
    minimum: 1
    maximum: 12
    description: Specifies the number of columns that comprise the trackpad.

  azoteq,conv-period:
    $ref: /schemas/types.yaml#/definitions/uint32
    minimum: 0
    maximum: 255
    description: Specifies the cycle's conversion period.

  azoteq,conv-frac:
    $ref: /schemas/types.yaml#/definitions/uint32
    minimum: 0
    maximum: 255
    description: Specifies the cycle's conversion frequency fraction.

  azoteq,conv-scale:
    $ref: /schemas/types.yaml#/definitions/uint32
    enum: [0, 1, 2, 3]
    description: |
      Specifies the channel's conversion frequency scaling factor as
      follows:
      0: 1
      1: 2
      2: 4
      3: 8

  azoteq,tx-enable:
    $ref: /schemas/types.yaml#/definitions/uint32-array
    minItems: 1
    maxItems: 9
    items:
      minimum: 0
      maximum: 8
    description: Specifies the CTx pin(s) associated with the cycle.

  azoteq,global-cap-increase:
    type: boolean
    description: Increases the global capacitance adder from 0.5 pF to 1.5 pF.

  azoteq,local-cap-size:
    $ref: /schemas/types.yaml#/definitions/uint32
    enum: [0, 1, 2]
    default: 0
    description: |
      Specifies the capacitance to be added to the channel as follows:
      0: None
      1: Global adder (based on 'azoteq,global-cap-increase')
      2: Global adder + 0.5 pF

  azoteq,rx-float-inactive:
    type: boolean
    description: Floats any inactive CRx pins instead of grounding them.

  azoteq,dead-time-enable:
    type: boolean
    description:
      Increases the denominator of the conversion frequency formula by one.

  azoteq,tx-freq-fosc:
    type: boolean
    description:
      Fixes the conversion frequency to that of the device's core clock.

  azoteq,tx-freq:
    $ref: /schemas/types.yaml#/definitions/uint32
    enum: [0, 1, 2, 3]
    default: 0
    description: |
      Specifies the inductive sensing excitation frequency as follows
      (parenthesized numbers represent the frequency if 'azoteq,clk-div'
      is present):
      0: 16 MHz (4 MHz)
      1: 8 MHz (2 MHz)
      2: 4 MHz (1 MHz)
      3: 2 MHz (500 kHz)

      This property is unavailable in the case of the ULP or Hall channels.

  azoteq,static-enable:
    type: boolean
    description: Enables the static front-end for the channel.

  azoteq,vbias-enable:
    type: boolean
    description: Enables the bias voltage for use during inductive sensing.

  azoteq,sense-mode:
    $ref: /schemas/types.yaml#/definitions/uint32
    enum: [0, 1, 2, 3]
    description: |
      Specifies the cycle's sensing mode as follows:
      0: None
      1: Self capacitive
      2: Mutual capacitive
      3: Inductive

      Note that in the case of IQS7222A, cycles 5 and 6 are restricted to
      Hall-effect sensing.

  azoteq,sense-freq:
    $ref: /schemas/types.yaml#/definitions/uint32
    enum: [0, 1, 2, 3]
    default: 1
    description: |
      Specifies the channel's sensing frequency as follows (parenthesized
      numbers represent the frequency if 'azoteq,clk-div' is present):
      0: 4 MHz (1 MHz)
      1: 2 MHz (500 kHz)
      2: 1 MHz (250 kHz)
      3: 500 kHz (125 kHz)

  azoteq,rx-inactive:
    $ref: /schemas/types.yaml#/definitions/uint32
    enum: [0, 1, 2, 3]
    description: |
      Specifies how inactive CRx pins are to be terminated as follows:
      0: Floating
      1: Bias voltage
      2: VSS
      3: VREG

  azoteq,tref-enable:
    type: boolean
    description:
      Enables the internal temperature-dependent current reference.

  azoteq,iref-enable:
    type: boolean
    description:
      Enables the current reference for use during various sensing modes.

  azoteq,iref-level:
    $ref: /schemas/types.yaml#/definitions/uint32
    minimum: 0
    maximum: 15
    description: Specifies the cycle's current reference level.

  azoteq,iref-trim:
    $ref: /schemas/types.yaml#/definitions/uint32
    minimum: 0
    maximum: 15
    description: Specifies the cycle's current reference trim.

  azoteq,ulp-allow:
    type: boolean
    description:
      Permits the device to enter ultra-low-power mode while the channel
      lies in a state of touch or proximity.

  azoteq,ref-select:
    $ref: /schemas/types.yaml#/definitions/uint32
    minimum: 0
    maximum: 9
    description: Specifies a separate reference channel to be followed.

  azoteq,ref-weight:
    $ref: /schemas/types.yaml#/definitions/uint32
    minimum: 0
    maximum: 65535
    description: Specifies the relative weight of the reference channel.

  azoteq,use-prox:
    type: boolean
    description:
      Activates the reference channel in response to proximity events
      instead of touch events.

  azoteq,counts-filt-enable:
    type: boolean
    description: Applies counts filtering to the channel.

  azoteq,filt-disable:
    type: boolean
    description: Disables raw count filtering for the channel.

  azoteq,ati-band:
    $ref: /schemas/types.yaml#/definitions/uint32
    enum: [0, 1, 2, 3]
    description: |
      Specifies the channel's ATI band as a fraction of its ATI target as
      follows:
      0: 1/16
      1: 1/8
      2: 1/4
      3: 1/2

  azoteq,global-halt:
    type: boolean
    description:
      Specifies that the channel's long-term average is to freeze if any
      other participating channel lies in a proximity or touch state.

  azoteq,invert-enable:
    type: boolean
    description:
      Inverts the polarity of the states reported for proximity and touch
      events relative to their respective thresholds.

  azoteq,dual-direction:
    type: boolean
    description:
      Specifies that the channel's long-term average is to freeze in the
      presence of either increasing or decreasing counts, thereby permit-
      ting events to be reported in either direction.

  azoteq,linearize:
    type: boolean
    description: Enables linearization of the channel's counts.

  azoteq,rx-enable:
    $ref: /schemas/types.yaml#/definitions/uint32-array
    minItems: 1
    maxItems: 4
    items:
      minimum: 0
      maximum: 7
    description: Specifies the CRx pin(s) associated with the channel.

  azoteq,meas-cap-decrease:
    type: boolean
    description:
      Decreases the internal measurement capacitance from 60 pF to 15 pF.

  azoteq,samp-cap-double:
    type: boolean
    description: Doubles the sampling capacitance from 40 pF to 80 pF.

  azoteq,vref-half:
    type: boolean
    description: Halves the discharge threshold from 1.0 V to 0.5 V.

  azoteq,proj-bias:
    $ref: /schemas/types.yaml#/definitions/uint32
    enum: [0, 1, 2, 3]
    description: |
      Specifies the bias current applied during mutual (projected)
      capacitive sensing as follows:
      0: 2 uA
      1: 5 uA
      2: 7 uA
      3: 10 uA

  azoteq,ati-target:
    $ref: /schemas/types.yaml#/definitions/uint32
    multipleOf: 8
    minimum: 0
    maximum: 2040
    description: Specifies the channel's ATI target.

  azoteq,ati-base:
    $ref: /schemas/types.yaml#/definitions/uint32
    multipleOf: 16
    minimum: 0
    maximum: 496
    description: Specifies the channel's ATI base.

  azoteq,ati-factor:
    $ref: /schemas/types.yaml#/definitions/uint32
    minimum: 0
    maximum: 4095
    description:
      Specifies the channel's automatic tuning implementation (ATI) resolu-
      tion factor, equal to 16 multiplied by the ATI target and divided by
      the ATI base.

  azoteq,ati-band-disable:
    type: boolean
    description: Disables the ATI band check.

  azoteq,ati-lp-only:
    type: boolean
    description: Limits automatic ATI to low-power mode.

  azoteq,ati-band-tighten:
    type: boolean
    description: Tightens the ATI band from 1/8 to 1/16 of the ATI target.

  azoteq,ati-mode:
    $ref: /schemas/types.yaml#/definitions/uint32
    enum: [0, 1, 2, 3, 4, 5]
    description: |
      Specifies the channel's ATI mode as follows:
      0: Disabled
      1: Compensation
      2: Compensation divider
      3: Fine fractional divider
      4: Coarse fractional divider
      5: Full

  azoteq,ati-frac-mult-fine:
    $ref: /schemas/types.yaml#/definitions/uint32
    minimum: 0
    maximum: 3
    description: Specifies the channel's ATI fine fractional multiplier.

  azoteq,ati-frac-div-fine:
    $ref: /schemas/types.yaml#/definitions/uint32
    minimum: 0
    maximum: 31
    description: Specifies the channel's ATI fine fractional divider.

  azoteq,ati-frac-mult-coarse:
    $ref: /schemas/types.yaml#/definitions/uint32
    minimum: 0
    maximum: 15
    description: Specifies the channel's ATI coarse fractional multiplier.

  azoteq,ati-frac-div-coarse:
    $ref: /schemas/types.yaml#/definitions/uint32
    minimum: 0
    maximum: 31
    description: Specifies the channel's ATI coarse fractional divider.

  azoteq,ati-comp-div:
    $ref: /schemas/types.yaml#/definitions/uint32
    minimum: 0
    maximum: 31
    description: Specifies the channel's ATI compensation divider.

  azoteq,ati-comp-select:
    $ref: /schemas/types.yaml#/definitions/uint32
    minimum: 0
    maximum: 1023
    description: Specifies the channel's ATI compensation selection.

  azoteq,debounce-enter:
    $ref: /schemas/types.yaml#/definitions/uint32
    minimum: 0
    maximum: 15
    description: Specifies the channel's debounce entrance factor.

  azoteq,debounce-exit:
    $ref: /schemas/types.yaml#/definitions/uint32
    minimum: 0
    maximum: 15
    description: Specifies the channel's debounce exit factor.

  azoteq,touch-enter:
    $ref: /schemas/types.yaml#/definitions/uint32
    minimum: 0
    maximum: 255
    description: Specifies the trackpad's touch entrance factor.

  azoteq,touch-exit:
    $ref: /schemas/types.yaml#/definitions/uint32
    minimum: 0
    maximum: 255
    description: Specifies the trackpad's touch exit factor.

  azoteq,timeout-press-disable:
    type: boolean
    description:
      Disables the press timeout for proximity or touch states reported by
      the channel.

  azoteq,gpio-select:
    $ref: /schemas/types.yaml#/definitions/uint32-array
    minItems: 1
    maxItems: 3
    items:
      minimum: 0
      maximum: 2
    description: |
      Specifies one or more GPIO mapped to the event as follows:
      0: GPIO0
      1: GPIO3
      2: GPIO4

      Note that although multiple events can be mapped to a single
      GPIO, they must all be of the same type (proximity, touch or
      slider/trackpad gesture).

  azoteq,thresh:
    $ref: /schemas/types.yaml#/definitions/uint32
    description:
      Specifies the threshold for the event. Valid entries range from
      0-127 and 0-255 for proximity and touch events, respectively.

  azoteq,hyst:
    $ref: /schemas/types.yaml#/definitions/uint32
    minimum: 0
    maximum: 255
    description:
      Specifies the hysteresis for the event (touch events only).

  azoteq,lta-track:
    type: boolean
    description:
      Multiplies the threshold by the channel's long-term average and
      divides it by 2^16.

  azoteq,channel-select:
    $ref: /schemas/types.yaml#/definitions/uint32-array
    minItems: 3
    maxItems: 4
    items:
      minimum: 0
      maximum: 9
    description:
      Specifies the order of the channels that participate in the slider.

  azoteq,slider-size:
    $ref: /schemas/types.yaml#/definitions/uint32
    minimum: 1
    maximum: 65535
    description:
      Specifies the slider's one-dimensional resolution, equal to the
      maximum coordinate plus one.

  azoteq,lower-cal:
    $ref: /schemas/types.yaml#/definitions/uint32
    minimum: 0
    maximum: 255
    description: Specifies the slider's lower starting point.

  azoteq,upper-cal:
    $ref: /schemas/types.yaml#/definitions/uint32
    minimum: 0
    maximum: 255
    description: Specifies the slider's upper starting point.

  azoteq,top-speed:
    $ref: /schemas/types.yaml#/definitions/uint32
    minimum: 0
    maximum: 65535
    description:
      Specifies the speed of movement after which coordinate filtering is
      no longer applied.

  azoteq,bottom-speed:
    $ref: /schemas/types.yaml#/definitions/uint32
    minimum: 0
    maximum: 255
    description:
      Specifies the speed of movement after which coordinate filtering is
      linearly reduced.

  azoteq,bottom-beta:
    $ref: /schemas/types.yaml#/definitions/uint32
    minimum: 0
    maximum: 7
    description:
      Specifies the coordinate filter damping factor to be applied
      while the speed of movement is below that which is specified
      by azoteq,bottom-speed.

  azoteq,static-beta:
    type: boolean
    description:
      Applies the coordinate filter damping factor specified by
      azoteq,bottom-beta regardless of the speed of movement.

  azoteq,gesture-mid-ms:
    minimum: 0
    maximum: 65535
    description:
      Specifies the maximum duration between subsequent tap gestures
      (IQS7211E only).

  azoteq,gesture-dist-rep:
    $ref: /schemas/types.yaml#/definitions/uint32
    minimum: 0
    maximum: 65535
    description:
      Specifies the minimum distance a finger must travel to elicit a
      repeated swipe gesture (IQS7211E only).

  azoteq,gesture-angle:
    $ref: /schemas/types.yaml#/definitions/uint32
    minimum: 0
    maximum: 75
    description:
      Specifies the maximum angle (in degrees) a finger may travel to
      be considered a swipe gesture.

  azoteq,gesture-angle-tighten:
    type: boolean
    description:
      Limits the tangent of the gesture angle to 0.5 (axial gestures
      only). If specified in one direction, the effect is applied in
      either direction.

  azoteq,gesture-max-ms:
    multipleOf: 16
    minimum: 0
    maximum: 4080
    description:
      Specifies the length of time (in ms) within which a tap, swipe
      or flick gesture must be completed in order to be acknowledged
      by the device. The number specified for any one swipe or flick
      gesture applies to all remaining swipe or flick gestures.

  azoteq,gesture-min-ms:
    multipleOf: 16
    minimum: 0
    maximum: 496
    description:
      Specifies the length of time (in ms) for which a tap gesture must
      be held in order to be acknowledged by the device.

  azoteq,gesture-dist:
    $ref: /schemas/types.yaml#/definitions/uint32
    multipleOf: 16
    minimum: 0
    maximum: 4080
    description:
      Specifies the distance across which a swipe or flick gesture must
      travel in order to be acknowledged by the device. The number spec-
      ified for any one swipe or flick gesture applies to all remaining
      swipe or flick gestures.

patternProperties:
  "^azoteq,lower-cal-(x|y)$":
    $ref: /schemas/types.yaml#/definitions/uint32
    minimum: 0
    maximum: 255
    description: Specifies the trackpad's lower starting points.

  "^azoteq,upper-cal-(x|y)$":
    $ref: /schemas/types.yaml#/definitions/uint32
    minimum: 0
    maximum: 255
    description: Specifies the trackpad's upper starting points.

dependencies:
  azoteq,iref-level: ["azoteq,iref-enable"]
  azoteq,iref-trim: ["azoteq,iref-enable"]
  azoteq,ref-weight: ["azoteq,ref-select"]

additionalProperties: true

...
```
